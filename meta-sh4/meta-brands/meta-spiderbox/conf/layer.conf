## meta-sh4/meta-brands/meta-spiderbox/conf/layer.conf
```bitbake
# We have a conf and classes directory, append to BBPATH
BBPATH .= ":${LAYERDIR}"

# We have a recipes directory, add to BBFILES
BBFILES += "${LAYERDIR}/recipes-*/*.bb ${LAYERDIR}/recipes-*/*.bbappend \
            ${LAYERDIR}/recipes-*/*/*.bb ${LAYERDIR}/recipes-*/*/*.bbappend \
            ${LAYERDIR}/recipes-*/*/*/*.bb ${LAYERDIR}/recipes-*/*/*/*.bbappend"

META-SPIDERBOX-BASE := '${@os.path.normpath("${LAYERDIR}/../")}'
# Prevent current directory creeping into sstate objects. Otherwise, building
# in another TOPDIR will cause recipes using this variable to be rebuilt.
META-spiderbox-BASE[vardepvalue] = 'meta-spiderbox'

LAYERSERIES_COMPAT_spiderbox-layer = "dunfell zeus"
# Additional license directories.
LICENSE_PATH += "${LAYERDIR}/conf/license"

DEBUG_PREFIX_MAP_sh4 = "-fdebug-prefix-map=${WORKDIR}=/usr/src/debug/${PN}/${EXTENDPE}${PV}-${PR} \
                     -fdebug-prefix-map=${STAGING_DIR_HOST}= \
                     -fdebug-prefix-map=${STAGING_DIR_NATIVE}= \
"

DEBUG_FLAGS_sh4 = "-g -feliminate-unused-debug-types ${DEBUG_PREFIX_MAP}"

# dont run update_gio_modules_cache - fails with kernel too old
# error on run postinstall intercept scripts at do_rootfs
GIO_MODULE_PACKAGES_sh4 = ""

WARN_QA_remove_sh4 = "ldflags textrel"
```

## meta-sh4/meta-oe/conf/layer.conf
```bitbake
# We have a conf and classes directory, append to BBPATH
BBPATH .= ":${LAYERDIR}"

# We have a recipes directory, add to BBFILES
BBFILES += "${LAYERDIR}/recipes-*/*.bb ${LAYERDIR}/recipes-*/*.bbappend \
            ${LAYERDIR}/recipes-*/*/*.bb ${LAYERDIR}/recipes-*/*/*.bbappend \
            ${LAYERDIR}/recipes-*/*/*/*.bb ${LAYERDIR}/recipes-*/*/*/*.bbappend"

METASH4_BASE := '${@os.path.normpath("${LAYERDIR}/../")}'
# Prevent current directory creeping into sstate objects. Otherwise, building
# in another TOPDIR will cause recipes using this variable to be rebuilt.
METASH4_BASE[vardepvalue] = 'meta-sh4'

# Additional license directories.
LICENSE_PATH += "${LAYERDIR}/conf/license"
```

## meta-sh4/meta-oe/recipes-openpli/conf/distro/openpli-common.conf
```bitbake
DISTRO_NAME_append_sh4 = "openpli"
DISTRO_HOST_append_sh4 = "runigma.com.ua"
DISTRO_VERSION_append_sh4 = "homebuild"
DISTRO_TYPE _append_sh4= "release"

IPKG_VARIANT = "opkg"

FEED_NAME_append_sh4 = "${DISTRO_NAME}-${DISTRO_VERSION}"
DISTRO_FEED_URI_append_sh4 = "http://${DISTRO_HOST}/feeds/${FEED_NAME}"
DISTRO_FEED_PREFIX _append_sh4= "${DISTRO_NAME}"
```

## meta-sh4/meta-oe/recipes-openpli/conf/distro/reporefs.conf
```bitbake
# skins
SRCREV_pn-enigma2-plugin-skins-mx-hq7 ??= "${AUTOREV}"
SRCREV_pn-enigma2-plugin-skins-mx-hq9w ??= "${AUTOREV}"

# fonts
SRCREV_pn-font-tiny ??= "${AUTOREV}"
```
